## config/boards/shields/led_indicator/Kconfig.defconfig
```kconfig
if SHIELD_LED_INDICATOR

config LED
    default y

config LED_INDICATOR_BATTERY_BLINK_MS
    int "Duration of battery level blink in ms"
    default 2000

config LED_INDICATOR_OUTPUT_BLINK_MS
    int "Duration of BLE connection status blink in ms"
    default 1000

config LED_INDICATOR_INTERVAL_MS
    int "Minimum wait duration between two blinks in ms"
    default 500

config LED_INDICATOR_BATTERY_LEVEL_HIGH
    int "High battery level percentage"
    default 80

config LED_INDICATOR_BATTERY_LEVEL_LOW
    int "Low battery level percentage"
    default 20

config LED_INDICATOR_BATTERY_LEVEL_CRITICAL
    int "Critical battery level percentage"
    default 5

config LED_INDICATOR_SHOW_LAYER_CHANGE
    bool "Indicate highest active layer on each layer change with a sequence of blinks"

config LED_INDICATOR_LAYER_BLINK_MS
    int "Blink and wait duration for layer indicator"
    default 100

endif
```
